## sdkconfig.defaults
```kconfig
# Rust often needs a bit of an extra main task stack size compared to C (the default is 3K)
CONFIG_ESP_MAIN_TASK_STACK_SIZE=32000
CONFIG_PTHREAD_TASK_STACK_SIZE_DEFAULT=6000

# Use this to set FreeRTOS kernel tick frequency to 1000 Hz (100 Hz by default).
# This allows to use 1 ms granularity for thread sleeps (10 ms by default).
#CONFIG_FREERTOS_HZ=1000

# Workaround for https://github.com/espressif/esp-idf/issues/7631
#CONFIG_MBEDTLS_CERTIFICATE_BUNDLE=n
#CONFIG_MBEDTLS_CERTIFICATE_BUNDLE_DEFAULT_FULL=n

# From Waveshare wiki
CONFIG_FREERTOS_HZ=1000
CONFIG_ESP_DEFAULT_CPU_FREQ_MHZ_240=y
CONFIG_ESPTOOLPY_FLASHMODE_QIO=y
CONFIG_ESPTOOLPY_FLASHFREQ_120M=y
# This is needed to enable PSRAM
CONFIG_SPIRAM=y
CONFIG_SPIRAM_MODE_OCT=y
CONFIG_IDF_EXPERIMENTAL_FEATURES=y
CONFIG_SPIRAM_SPEED_120M=y
CONFIG_SPIRAM_FETCH_INSTRUCTIONS=y
CONFIG_SPIRAM_RODATA=y
CONFIG_ESP32S3_DATA_CACHE_LINE_64B=y
CONFIG_COMPILER_OPTIMIZATION_PERF=y

# TinyUSB Configuration
# Enable TinyUSB stack
CONFIG_TINYUSB=y
CONFIG_TINYUSB_ENABLED=y
# --- Descriptor Configuration ---
# Custom VID/PID
CONFIG_TINYUSB_DESC_CUSTOM_VID=0x5AA4
CONFIG_TINYUSB_DESC_CUSTOM_PID=0x60E1

CONFIG_TINYUSB_DESC_MANUFACTURER_STRING="Shaan Labs Inc."
CONFIG_TINYUSB_DESC_PRODUCT_STRING="ESP DECK"
CONFIG_TINYUSB_DESC_SERIAL_STRING="42069"
# CONFIG_TINYUSB_DESC_HID_STRING="ESP DECK HID Device"

# --- HID Configuration ---
CONFIG_TINYUSB_CDC_ENABLED=n   # Disable CDC unless you need it
CONFIG_TINYUSB_MSC_ENABLED=n   # Disable Mass Storage unless needed
CONFIG_TINYUSB_HID_ENABLED=y
CONFIG_TINYUSB_HID_COUNT=1
# CONFIG_TINYUSB_HID_BUFSIZE=64

# Enable specific HID types we need for composite device
# CONFIG_TINYUSB_HID_KEYBOARD_ENABLED=y
# CONFIG_TINYUSB_HID_MOUSE_ENABLED=y
# Use "Generic" for Consumer Control or other custom reports
# CONFIG_TINYUSB_HID_GENERIC_ENABLED=y

# --- IMPORTANT: Use Custom Report Descriptor ---
# CONFIG_TINYUSB_DESC_CUSTOM_HID_REPORT=y

# --- Optional: Power Config ---
CONFIG_USB_OTG_SUPPORT_DEVICE=y
CONFIG_USB_OTG_DEVICE_POWERED_BY_VBUS=y # Bus powered

CONFIG_TINYUSB_DEBUG_LEVEL=1
CONFIG_TINYUSB_TASK_PRIORITY=5
CONFIG_TINYUSB_TASK_STACK_SIZE=4096
CONFIG_TINYUSB_TASK_AFFINITY_NO_AFFINITY=y
CONFIG_TINYUSB_DFU_MODE_NONE=y
CONFIG_TINYUSB_NET_MODE_NONE=y
CONFIG_TINYUSB_DESC_BCD_DEVICE=0x0100

# For WebUSB to Worka
# CONFIG_TINYUSB_CDC_ENABLED=y

# Partition Table 
CONFIG_PARTITION_TABLE_CUSTOM=y
CONFIG_PARTITION_TABLE_CUSTOM_FILENAME="c:\\Users\\shant\\dev\\esp\\esp-deck\\partition-table.csv"
CONFIG_PARTITION_TABLE_OFFSET=0x8000
CONFIG_PARTITION_TABLE_MD5=y

# Fix Flash size
CONFIG_ESPTOOLPY_FLASHSIZE_16MB=y
CONFIG_ESPTOOLPY_HEADER_FLASHSIZE_UPDATE=y
```
